## watch/sdkconfig.defaults
```kconfig
## 目标与 Flash（本板为 32MB NOR Flash）
CONFIG_IDF_TARGET="esp32s3"
CONFIG_ESPTOOLPY_FLASHMODE_QIO=y
CONFIG_ESPTOOLPY_FLASHFREQ_80M=y
CONFIG_ESPTOOLPY_FLASHSIZE_32MB=y
CONFIG_PARTITION_TABLE_CUSTOM=y
CONFIG_PARTITION_TABLE_CUSTOM_FILENAME="partitions.csv"

## PSRAM：8MB Octal @80MHz
CONFIG_SPIRAM=y
CONFIG_SPIRAM_MODE_OCT=y
CONFIG_SPIRAM_SPEED_80M=y
CONFIG_SPIRAM_FETCH_INSTRUCTIONS=y
CONFIG_SPIRAM_RODATA=y

## CPU / 系统
CONFIG_ESP_DEFAULT_CPU_FREQ_MHZ_240=y
CONFIG_FREERTOS_HZ=1000
CONFIG_COMPILER_OPTIMIZATION_PERF=y
CONFIG_ESP32S3_DATA_CACHE_LINE_64B=y

## 控制台：板载 Type-C 接的是 ESP32-S3 原生 USB（GPIO19/20）
CONFIG_ESP_CONSOLE_USB_SERIAL_JTAG=y

## LVGL 字号（中文字形由 tiny_ttf + storage 里的 font-cjk.ttf 提供，
## 这里保留 Montserrat 作为字库缺失时的兜底；40 px 给秒表大数字）
CONFIG_LV_FONT_MONTSERRAT_14=y
CONFIG_LV_FONT_MONTSERRAT_16=y
CONFIG_LV_FONT_MONTSERRAT_20=y
CONFIG_LV_FONT_MONTSERRAT_28=y
CONFIG_LV_FONT_MONTSERRAT_40=y

## 中文渲染：字体文件在 storage 分区，由 components/cjk_font 读进 PSRAM
CONFIG_LV_USE_TINY_TTF=y
CONFIG_LV_TINY_TTF_CACHE_GLYPH_CNT=512
CONFIG_LV_TINY_TTF_CACHE_KERNING_CNT=256
# 内置 64KB 内存池放不下字形缓存
# CONFIG_LV_USE_BUILTIN_MALLOC is not set
CONFIG_LV_USE_CLIB_MALLOC=y
CONFIG_LV_USE_STDLIB_MALLOC=1

## SPIFFS：必须和 tools/pack_storage.ps1 的参数一致（读取共享字库用）
CONFIG_SPIFFS_PAGE_SIZE=512
CONFIG_SPIFFS_OBJ_NAME_LEN=32
CONFIG_SPIFFS_META_LENGTH=4
CONFIG_SPIFFS_USE_MAGIC=y
CONFIG_SPIFFS_USE_MAGIC_LENGTH=y
```

## xiaozhi/main/Kconfig.projbuild
```kconfig
menu "Xiaozhi app"

    config XZ_WIFI_SSID
        string "Wi-Fi SSID"
        default ""
        help
            设备连接的路由器名称。留空时设备启动后停在 "NO WIFI CONFIG" 状态。

    config XZ_WIFI_PASSWORD
        string "Wi-Fi password"
        default ""

    config XZ_WIFI_MAX_RETRY
        int "Wi-Fi connect retry count"
        range 1 20
        default 5

    config XZ_BOOT_BUTTON_GPIO
        int "BOOT key GPIO"
        default 0
        help
            BOOT 键 GPIO。长按 3 秒回 selector；短按在应用内开始/停止对话。

    config XZ_MIC_GAIN_DB
        int "Microphone gain (dB)"
        range 0 42
        default 24

    config XZ_SPK_VOLUME
        int "Speaker volume (0-100)"
        range 0 100
        default 70

endmenu
```
